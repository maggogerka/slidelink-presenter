## main/Kconfig.projbuild
```kconfig
menu "SlideLink product configuration"

config SLIDELINK_DEVELOPMENT_BUILD
    bool "Development build"
    default y
    help
        Enables development-only diagnostics such as printing the unique initial
        setup credential on UART. Disable this in the production configuration.

config SLIDELINK_USB_VID
    hex "USB vendor ID"
    range 0x0001 0xFFFF
    default 0x303A
    help
        Espressif's VID is suitable only for development. Commercial hardware
        must use a VID/PID assigned or sublicensed to the manufacturer.

config SLIDELINK_USB_PID
    hex "USB product ID"
    range 0x0001 0xFFFF
    default 0x4005

config SLIDELINK_USB_MANUFACTURER
    string "USB manufacturer"
    default "SlideLink"

config SLIDELINK_BUTTON_NEXT_GPIO
    int "NEXT / single-button GPIO"
    range 0 48
    default 0
    help
        GPIO 0 is the BOOT button on the supported development board.

config SLIDELINK_BUTTON_PREVIOUS_GPIO
    int "Optional dedicated PREVIOUS GPIO (-1 disables)"
    range -1 48
    default -1

endmenu
```

## sdkconfig.defaults
```kconfig
# SlideLink targets the ESP32-S3 native USB peripheral and autonomous SoftAP.
CONFIG_IDF_TARGET="esp32s3"
CONFIG_ESPTOOLPY_FLASHSIZE_16MB=y
CONFIG_PARTITION_TABLE_CUSTOM=y
CONFIG_PARTITION_TABLE_CUSTOM_FILENAME="partitions.csv"
CONFIG_PARTITION_TABLE_OFFSET=0x8000
CONFIG_BOOTLOADER_APP_ROLLBACK_ENABLE=y
CONFIG_ESP_COREDUMP_ENABLE_TO_FLASH=y
CONFIG_SLIDELINK_DEVELOPMENT_BUILD=y
CONFIG_SLIDELINK_USB_VID=0x303A
CONFIG_SLIDELINK_USB_PID=0x4005
CONFIG_SLIDELINK_USB_MANUFACTURER="SlideLink"
CONFIG_SLIDELINK_BUTTON_NEXT_GPIO=0
CONFIG_SLIDELINK_BUTTON_PREVIOUS_GPIO=-1
CONFIG_TINYUSB_HID_COUNT=1
CONFIG_TINYUSB_NET_MODE_NCM=y
CONFIG_TINYUSB_NCM_OUT_NTB_BUFFS_COUNT=3
CONFIG_TINYUSB_NCM_IN_NTB_BUFFS_COUNT=3
CONFIG_TINYUSB_NCM_OUT_NTB_BUFF_MAX_SIZE=3200
CONFIG_TINYUSB_NCM_IN_NTB_BUFF_MAX_SIZE=3200
CONFIG_TINYUSB_SUSPEND_CALLBACK=y
CONFIG_TINYUSB_RESUME_CALLBACK=y
CONFIG_ESP_CONSOLE_UART_DEFAULT=y
CONFIG_ESP_CONSOLE_UART_NUM=0
CONFIG_ESP_CONSOLE_UART_BAUDRATE=115200
CONFIG_ESP_CONSOLE_SECONDARY_NONE=y
CONFIG_COMPILER_OPTIMIZATION_PERF=y
CONFIG_ESP_SYSTEM_PANIC_PRINT_REBOOT=y
CONFIG_ESP_TASK_WDT_EN=y
CONFIG_ESP_TASK_WDT_INIT=y
CONFIG_HTTPD_WS_SUPPORT=y
```

## tests/sdkconfig.defaults
```kconfig
CONFIG_IDF_TARGET="esp32s3"
CONFIG_ESP_CONSOLE_UART_DEFAULT=y
CONFIG_ESP_CONSOLE_SECONDARY_NONE=y
CONFIG_COMPILER_OPTIMIZATION_PERF=y
CONFIG_ESP_TASK_WDT_EN=n
```
